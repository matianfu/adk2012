



// N O T E :
// This is an experimental file autogenerated by an XSL transformation.
// Read more about the purpose of this file and how it was generated here:
// http://avrtools.norway.atmel.com/pmwiki/pmwiki.php?n=Software.XmegaFiles
//////////////////////////////////////////////////////////////////////////////

// Set up XLINK
-ca90
-w29

// Memory size definitions for convenience
// The '_..X_' prefix is used by C-SPY as an indication that the label should
// not be displayed in the dissassembly window.

-D_..X_FLASH_BASE=20002
-D_..X_CODE_END=21FFF
-D_..X_INTVEC_END=201FB




//////////////////////////////////////////////////////////////////////////////
// Code (flash) segments
-Z(CODE)INTVEC=2007C-2008C
-Z(CODE)CODE,BOOT=2008C-_..X_CODE_END
-Z(CODE)FARCODE=2008C-_..X_CODE_END
-Z(CODE)INITTAB=2008C-_..X_CODE_END
-Z(CODE)NEAR_ID=2008C-_..X_CODE_END




-D_..X_SRAM_BASE=2040
-D_..X_SRAM_TINY_END=FF
-D_..X_SRAM_NEAR_END=FFFF
-D_..X_SRAM_FAR_END=FFFFFF
-D_..X_SRAM_HUGE_END=FFFFFF

/*
 * Modify the lines below to alter the size of the RSTACK, CSTACK and HEAP
 * segments. These need to be fine tuned to suit your specific application.
 */
-D_..X_CSTACK_SIZE=1000 /* 4096 bytes for auto variables and register save. */
-D_..X_RSTACK_SIZE=100  /* 256 bytes for return addresses, equivalent to */
                        /* 128 levels of calls, including interrupts. */
-D_..X_NEAR_HEAP_SIZE=1000   /* 4096 bytes of heap. */
-D_..X_HEAP_SIZE=1000   /* 4096 bytes of heap. */
-D_..X_FAR_HEAP_SIZE=1000   /* 4096 bytes of heap. */
-D_..X_HUGE_HEAP_SIZE=1000   /* 4096 bytes of heap. */
//////////////////////////////////////////////////////////////////////////////
// Data (SRAM, external ROM or external NV RAM) memory
-Z(DATA)SRAM_NO_INIT=2000-2001
-Z(DATA)TINY_I,TINY_Z,TINY_N=_..X_SRAM_BASE-_..X_SRAM_NEAR_END
-Z(DATA)RSTACK+_..X_RSTACK_SIZE=_..X_SRAM_BASE-_..X_SRAM_NEAR_END
-Z(DATA)NEAR_I,NEAR_Z,NEAR_N,NEAR_C=_..X_SRAM_BASE-_..X_SRAM_NEAR_END
-Z(DATA)NEAR_HEAP+_..X_NEAR_HEAP_SIZE=_..X_SRAM_BASE-_..X_SRAM_NEAR_END
//-Z(DATA)FAR_I=[10000-_..X_SRAM_FAR_END]/10000
-Z(DATA)CSTACK+_..X_CSTACK_SIZE=[_..X_SRAM_BASE-_..X_SRAM_FAR_END]/10000
-Z(DATA)HEAP+_..X_HEAP_SIZE=[_..X_SRAM_BASE-_..X_SRAM_FAR_END]/10000
-Z(DATA)IOSTREAM_N#[_..X_SRAM_BASE-_..X_SRAM_FAR_END]/10000
-Z(DATA)FAR_Z,FAR_N,FAR_C=[_..X_SRAM_BASE-_..X_SRAM_FAR_END]/10000
-Z(DATA)FAR_HEAP+_..X_FAR_HEAP_SIZE=_..X_SRAM_BASE-_..X_SRAM_FAR_END
-Z(DATA)HUGE_I,HUGE_Z,HUGE_N,HUGE_C=_..X_SRAM_BASE-_..X_SRAM_HUGE_END
-Z(DATA)HUGE_HEAP+_..X_HUGE_HEAP_SIZE=_..X_SRAM_BASE-_..X_SRAM_HUGE_END




